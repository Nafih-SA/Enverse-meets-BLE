## CMakeLists.txt
```
# SPDX-License-Identifier: Apache-2.0

cmake_minimum_required(VERSION 2.8.12)
find_package(Zephyr REQUIRED HINTS $ENV{ZEPHYR_BASE})
project(enverse_ble_intgrated)


target_sources(app PRIVATE src/main.c)
target_sources(app PRIVATE src/bma_sensor.c)
target_sources(app PRIVATE src/bma4.c)
target_sources(app PRIVATE src/bma456.c)
target_sources(app PRIVATE src/max30102.c)
target_sources(app PRIVATE src/latchSensor.c)
target_sources(app PRIVATE src/max30208.c)
target_sources(app PRIVATE src/lightSensor.c)
target_sources(app PRIVATE src/algorithm.c)
target_sources(app PRIVATE src/display.c)
target_sources(app PRIVATE src/lcd.c)
target_sources(app PRIVATE src/lcd.h)
target_sources(app PRIVATE src/display.h)
target_sources(app PRIVATE src/algorithm.h)
target_sources(app PRIVATE src/digitalPins.c)
target_sources(app PRIVATE src/digitalPins.h)
target_sources(app PRIVATE src/lightSensor.h)
target_sources(app PRIVATE src/max30208.h)
target_sources(app PRIVATE src/latchSensor.h)
target_sources(app PRIVATE src/max30102.h)
target_sources(app PRIVATE src/bma_sensor.h)
target_sources(app PRIVATE src/bma4.h)
target_sources(app PRIVATE src/bma456.h)
target_sources(app PRIVATE src/bma4_defs.h)

target_sources(app PRIVATE src/hts.h)
target_sources(app PRIVATE src/hts.c)
```

## prj.conf
```kconfig
##########
# for BLE
##########
# Incresed stack due to settings API usage
CONFIG_SYSTEM_WORKQUEUE_STACK_SIZE=2048

CONFIG_BT=y
CONFIG_BT_DEBUG_LOG=y
CONFIG_BT_SMP=y
CONFIG_BT_SIGNING=y
CONFIG_BT_PERIPHERAL=y
### GATT Device Information service ###
# CONFIG_BT_DIS=y
CONFIG_BT_ATT_PREPARE_COUNT=5
# CONFIG_BT_BAS=y
CONFIG_BT_HRS=y
CONFIG_BT_PRIVACY=y
CONFIG_BT_DEVICE_NAME="Zephyr nRF52840 Enverse"
CONFIG_BT_DEVICE_APPEARANCE=833
CONFIG_BT_DEVICE_NAME_DYNAMIC=y
CONFIG_BT_DEVICE_NAME_MAX=65

CONFIG_BT_KEYS_OVERWRITE_OLDEST=y
CONFIG_BT_SETTINGS=y
CONFIG_FLASH=y
CONFIG_FLASH_PAGE_LAYOUT=y
CONFIG_FLASH_MAP=y
CONFIG_NVS=y
CONFIG_SETTINGS=y

# Turnoff to aboid possible race conditions
#CONFIG_BT_ATT_ENFORCE_FLOW=n
#Floating point support
CONFIG_CBPRINTF_FP_SUPPORT=y
CONFIG_BT_DEVICE_APPEARANCE=768

#
# General 
#
CONFIG_STDOUT_CONSOLE=y
CONFIG_PRINTK=y
#
# I2C
#
CONFIG_I2C=y
#
# SPI
#
CONFIG_SPI=y
CONFIG_SPI_2=y
# CONFIG_NRFX_SPI=y
# CONFIG_NRFX_SPI0 is not set
# CONFIG_NRFX_SPI1 is not set
# CONFIG_NRFX_SPI2=y


#
# Build Options
#
CONFIG_KERNEL_BIN_NAME="zephyr"
CONFIG_OUTPUT_STAT=y
CONFIG_OUTPUT_DISASSEMBLY=y
# CONFIG_OUTPUT_DISASSEMBLE_ALL is not set
CONFIG_OUTPUT_PRINT_MEMORY_USAGE=y
# CONFIG_CLEANUP_INTERMEDIATE_FILES is not set
# CONFIG_BUILD_NO_GAP_FILL is not set
CONFIG_BUILD_OUTPUT_BIN=y
# CONFIG_BUILD_OUTPUT_EXE is not set
# CONFIG_BUILD_OUTPUT_S19 is not set
# CONFIG_BUILD_OUTPUT_STRIPPED is not set
# CONFIG_APPLICATION_DEFINED_SYSCALL is not set
# CONFIG_MAKEFILE_EXPORTS is not set
CONFIG_DEPRECATED_ZEPHYR_INT_TYPES=y

#
# C Library
#
# # CONFIG_MINIMAL_LIBC=y
# CONFIG_NEWLIB_LIBC=y
```

## src/main.c
```c
/*
 * Copyright (c) 2015 Intel Corporation
 *
 * SPDX-License-Identifier: Apache-2.0
 */

#include <errno.h>
#include <zephyr.h>
#include <sys/printk.h>
#include <device.h>
#include <drivers/i2c.h>
#include <stdio.h>

#include "bma_sensor.h"
#include "max30102.h"
#include "latchSensor.h"
#include "max30208.h"
#include "lightSensor.h"
#include "digitalPins.h"
#include "lcd.h"

/** BLE **/
#include <zephyr/types.h>
#include <stddef.h>
#include <string.h>
#include <settings/settings.h>

#include <bluetooth/bluetooth.h>
#include <bluetooth/hci.h>
#include <bluetooth/conn.h>
#include <bluetooth/uuid.h>
#include <bluetooth/gatt.h>
#include <bluetooth/services/hrs.h>
#include "hts.h"

// #define LOG_LEVEL CONFIG_BT_CSTM_LOG_LEVEL
// #include <logging/log.h>
// LOG_MODULE_REGISTER(hrs);

/// Variable to store data ///
float temp_data = 0, light_data = 0;
uint16_t mpu_data = 0;
u32_t red, ir;
int steps = 0;
int heart_rate, sp02;
bool valid_hr, valid_sp02;

/***********								************/
/* Primary Service UUID */
static struct bt_uuid_128 vnd_uuid = BT_UUID_INIT_128(
	0xf0, 0xde, 0xbc, 0x9a, 0x78, 0x56, 0x34, 0x12,
	0x78, 0x56, 0x34, 0x12, 0x78, 0x56, 0x34, 0x12);

/* Primary Service Characteristic UUID(s) */
static struct bt_uuid_128 vnd_enc_uuid = BT_UUID_INIT_128(
	0xf1, 0xde, 0xbc, 0x9a, 0x78, 0x56, 0x34, 0x12,
	0x78, 0x56, 0x34, 0x12, 0x78, 0x56, 0x34, 0x12);

static struct bt_uuid_128 vnd_auth_uuid = BT_UUID_INIT_128(
	0xf2, 0xde, 0xbc, 0x9a, 0x78, 0x56, 0x34, 0x12,
	0x78, 0x56, 0x34, 0x12, 0x78, 0x56, 0x34, 0x12);

static uint8_t vnd_value[] = { 'a', 'b', 'c', 'd', 'e', '1' };

/* Primary Service read callback */
static ssize_t read_vnd(struct bt_conn *conn, const struct bt_gatt_attr *attr,
			void *buf, uint16_t len, uint16_t offset)
{
	const char *value = attr->user_data;

	return bt_gatt_attr_read(conn, attr, buf, len, offset, value,
				 strlen(value));
}

/* Primary Service write callback */
static ssize_t write_vnd(struct bt_conn *conn, const struct bt_gatt_attr *attr,
			 const void *buf, uint16_t len, uint16_t offset,
			 uint8_t flags)
{
	uint8_t *value = attr->user_data;

	if (offset + len > sizeof(vnd_value)) {
		return BT_GATT_ERR(BT_ATT_ERR_INVALID_OFFSET);
	}

	memcpy(value + offset, buf, len);

	return len;
}

static uint8_t simulate_vnd;
static uint8_t indicating;
static struct bt_gatt_indicate_params ind_params;

/* Primary Service Configuration changed callback */
static void vnd_ccc_cfg_changed(const struct bt_gatt_attr *attr, uint16_t value)
{
	simulate_vnd = (value == BT_GATT_CCC_INDICATE) ? 1 : 0;
	bool notif_enabled = (value == BT_GATT_CCC_NOTIFY);

	printk("CSTM notifications %s", notif_enabled ? "enabled" : "disabled");
}

static void indicate_cb(struct bt_conn *conn,
			struct bt_gatt_indicate_params *params, uint8_t err)
{
	printk("Indication %s\n", err != 0U ? "fail" : "success");
}

static void indicate_destroy(struct bt_gatt_indicate_params *params)
{
	printk("Indication complete\n");
	indicating = 0U;
}

#define MAX_DATA 74
static uint8_t vnd_long_value[] = {
		  'V', 'e', 'n', 'd', 'o', 'r', ' ', 'd', 'a', 't', 'a', '1',
		  'V', 'e', 'n', 'd', 'o', 'r', ' ', 'd', 'a', 't', 'a', '2',
		  'V', 'e', 'n', 'd', 'o', 'r', ' ', 'd', 'a', 't', 'a', '3',
		  'V', 'e', 'n', 'd', 'o', 'r', ' ', 'd', 'a', 't', 'a', '4',
		  'V', 'e', 'n', 'd', 'o', 'r', ' ', 'd', 'a', 't', 'a', '5',
		  'V', 'e', 'n', 'd', 'o', 'r', ' ', 'd', 'a', 't', 'a', '6',
		  '.', ' ' };

static ssize_t read_long_vnd(struct bt_conn *conn,
			     const struct bt_gatt_attr *attr, void *buf,
			     uint16_t len, uint16_t offset)
{
	const char *value = attr->user_data;

	return bt_gatt_attr_read(conn, attr, buf, len, offset, value,
				 sizeof(vnd_long_value));
}

static ssize_t write_long_vnd(struct bt_conn *conn,
			      const struct bt_gatt_attr *attr, const void *buf,
			      uint16_t len, uint16_t offset, uint8_t flags)
{
	uint8_t *value = attr->user_data;

	if (flags & BT_GATT_WRITE_FLAG_PREPARE) {
		return 0;
	}

	if (offset + len > sizeof(vnd_long_value)) {
		return BT_GATT_ERR(BT_ATT_ERR_INVALID_OFFSET);
	}

	memcpy(value + offset, buf, len);

	return len;
}

static const struct bt_uuid_128 vnd_long_uuid = BT_UUID_INIT_128(
	0xf3, 0xde, 0xbc, 0x9a, 0x78, 0x56, 0x34, 0x12,
	0x78, 0x56, 0x34, 0x12, 0x78, 0x56, 0x34, 0x12);

static struct bt_gatt_cep vnd_long_cep = {
	.properties = BT_GATT_CEP_RELIABLE_WRITE,
};

static int signed_value;

static ssize_t read_signed(struct bt_conn *conn, const struct bt_gatt_attr *attr,
			   void *buf, uint16_t len, uint16_t offset)
{
	const char *value = attr->user_data;

	return bt_gatt_attr_read(conn, attr, buf, len, offset, value,
				 sizeof(signed_value));
}

static ssize_t write_signed(struct bt_conn *conn, const struct bt_gatt_attr *attr,
			    const void *buf, uint16_t len, uint16_t offset,
			    uint8_t flags)
{
	uint8_t *value = attr->user_data;

	if (offset + len > sizeof(signed_value)) {
		return BT_GATT_ERR(BT_ATT_ERR_INVALID_OFFSET);
	}

	memcpy(value + offset, buf, len);

	return len;
}

static const struct bt_uuid_128 vnd_signed_uuid = BT_UUID_INIT_128(
	0xf3, 0xde, 0xbc, 0x9a, 0x78, 0x56, 0x34, 0x13,
	0x78, 0x56, 0x34, 0x12, 0x78, 0x56, 0x34, 0x13);

static const struct bt_uuid_128 vnd_write_cmd_uuid = BT_UUID_INIT_128(
	0xf4, 0xde, 0xbc, 0x9a, 0x78, 0x56, 0x34, 0x12,
	0x78, 0x56, 0x34, 0x12, 0x78, 0x56, 0x34, 0x12);

/************* 'Send To' function	*************/
static ssize_t write_without_rsp_vnd(struct bt_conn *conn,
				     const struct bt_gatt_attr *attr,
				     const void *buf, uint16_t len, uint16_t offset,
				     uint8_t flags)
{
	uint8_t *value = attr->user_data;
	
	// printk(value);	// To print received value

	/* Write request received. Reject it since this char only accepts
	 * Write Commands.
	 */
	if (!(flags & BT_GATT_WRITE_FLAG_CMD)) {
		return BT_GATT_ERR(BT_ATT_ERR_WRITE_REQ_REJECTED);
	}

	if (offset + len > sizeof(vnd_value)) {
		return BT_GATT_ERR(BT_ATT_ERR_INVALID_OFFSET);
	}

	memcpy(value + offset, buf, len);

	return len;
}

/************* Service Table of "unknown service" *************/
/* Vendor Primary Service Declaration */
BT_GATT_SERVICE_DEFINE(vnd_svc,							//Macro that define and register a service
	BT_GATT_PRIMARY_SERVICE(&vnd_uuid),					//Primary Service Declaration Macro
	BT_GATT_CHARACTERISTIC(&vnd_enc_uuid.uuid,			//Characteristic and Value Declaration Macro (Chara uuid,
			       BT_GATT_CHRC_READ | BT_GATT_CHRC_WRITE |	//Characteristic Attribute properties,
			       BT_GATT_CHRC_INDICATE /*| BT_GATT_CHRC_NOTIFY*/,
			       BT_GATT_PERM_READ_ENCRYPT |			//Characteristic Attribute access permissions,
			       BT_GATT_PERM_WRITE_ENCRYPT,
			       read_vnd, write_vnd, vnd_value),		//read,write Callbacks, Attribute value)
	BT_GATT_CCC(vnd_ccc_cfg_changed,					//Client Characteristic Configuration Declaration Macro
		    BT_GATT_PERM_READ | BT_GATT_PERM_WRITE_ENCRYPT), //CCC Access permissons
	BT_GATT_CHARACTERISTIC(&vnd_auth_uuid.uuid,
			       BT_GATT_CHRC_READ | BT_GATT_CHRC_WRITE,
			       BT_GATT_PERM_READ_AUTHEN |
			       BT_GATT_PERM_WRITE_AUTHEN,
			       read_vnd, write_vnd, vnd_value),
	BT_GATT_CHARACTERISTIC(&vnd_long_uuid.uuid, BT_GATT_CHRC_READ |
			       BT_GATT_CHRC_WRITE | BT_GATT_CHRC_EXT_PROP,
			       BT_GATT_PERM_READ | BT_GATT_PERM_WRITE |
			       BT_GATT_PERM_PREPARE_WRITE,
			       read_long_vnd, write_long_vnd, &vnd_long_value),
	BT_GATT_CEP(&vnd_long_cep),							//Characteristic Extended Properties Declaration Macro
	BT_GATT_CHARACTERISTIC(&vnd_signed_uuid.uuid, BT_GATT_CHRC_READ |
			       BT_GATT_CHRC_WRITE | BT_GATT_CHRC_AUTH,
			       BT_GATT_PERM_READ | BT_GATT_PERM_WRITE,
			       read_signed, write_signed, &signed_value),
	BT_GATT_CHARACTERISTIC(&vnd_write_cmd_uuid.uuid,
			       BT_GATT_CHRC_WRITE_WITHOUT_RESP,
			       BT_GATT_PERM_WRITE, NULL,
			       write_without_rsp_vnd, &vnd_value),
);

/************* Advertisement Data *************/
//u8_t ----> unsigned char
static volatile unsigned char mfg_data[] = { 0x00, 0x00, 0xaa, 0xbb };
static const struct bt_data ad[] = {
	BT_DATA_BYTES(BT_DATA_FLAGS, (BT_LE_AD_GENERAL | BT_LE_AD_NO_BREDR)),
	BT_DATA_BYTES(BT_DATA_UUID16_ALL,
			// BT_UUID_16_ENCODE(BT_UUID_CTS_VAL),
	// 		BT_UUID_16_ENCODE(BT_UUID_BAS_VAL),
			BT_UUID_16_ENCODE(BT_UUID_HRS_VAL)),
	BT_DATA(BT_DATA_MANUFACTURER_DATA, mfg_data, 4),
	BT_DATA_BYTES(BT_DATA_UUID128_ALL,
		      0xf0, 0xde, 0xbc, 0x9a, 0x78, 0x56, 0x34, 0x12,
		      0x78, 0x56, 0x34, 0x12, 0x78, 0x56, 0x34, 0x12),
};

static void connected(struct bt_conn *conn, uint8_t err)
{
	if (err) {
		printk("Connection failed (err 0x%02x)\n", err);
	} else {
		printk("Connected\n");
	}
}

static void disconnected(struct bt_conn *conn, uint8_t reason)
{
	printk("Disconnected (reason 0x%02x)\n", reason);
}

static struct bt_conn_cb conn_callbacks = {
	.connected = connected,
	.disconnected = disconnected,
};

static void bt_ready(void)
{
	int err;

	printk("Bluetooth initialized\n");

	// cts_init();
	hts_init();		// Health Thermometer Initialize

	if (IS_ENABLED(CONFIG_SETTINGS)) {
		settings_load();
	}

	err = bt_le_adv_start(BT_LE_ADV_CONN_NAME, ad, ARRAY_SIZE(ad), NULL, 0);
	if (err) {
		printk("Advertising failed to start (err %d)\n", err);
		return;
	}

	printk("Advertising successfully started\n");
}

static void auth_passkey_display(struct bt_conn *conn, unsigned int passkey)
{
	char addr[BT_ADDR_LE_STR_LEN];

	bt_addr_le_to_str(bt_conn_get_dst(conn), addr, sizeof(addr));

	printk("Passkey for %s: %06u\n", addr, passkey);
}

static void auth_cancel(struct bt_conn *conn)
{
	char addr[BT_ADDR_LE_STR_LEN];

	bt_addr_le_to_str(bt_conn_get_dst(conn), addr, sizeof(addr));

	printk("Pairing cancelled: %s\n", addr);
}

static struct bt_conn_auth_cb auth_cb_display = {
	.passkey_display = auth_passkey_display,
	.passkey_entry = NULL,
	.cancel = auth_cancel,
};

/************* 
static void bas_notify(void)
{
	uint8_t battery_level = bt_bas_get_battery_level();

	battery_level--;

	if (!battery_level) {
		battery_level = 100U;
	}

	bt_bas_set_battery_level(battery_level);
}
**************/

static void hrs_notify(void)
{
	// static uint8_t heartrate = 90U;

	/* Heartrate measurements simulation */
	// heartrate++;
	if (heart_rate > 200U) {
		heart_rate = 0U;
	}

	bt_hrs_notify(heart_rate);
}


/***********								************/
/**
 * @file Enverse Smart Wearable Firmware
 */

// LCD values //
bool lcd_init = 0;
#define DISPLAY_MODE_BOOTING 0
#define DISPLAY_MODE_TIME 1
#define DISPLAY_MODE_OFF 2
#define DISPLAY_MODE_ON 3
#define DISPLAY_MODE_VALUES 4
int display_mode = DISPLAY_MODE_BOOTING;

#define SENSOR_MODE_IDLE 0
#define SENSOR_MODE_READ_ALL 1
int sensor_mode = SENSOR_MODE_IDLE;



//////////////////////////////
bool latch_status = true;

/// FSM variables  ///
int current_state_display = DISPLAY_MODE_BOOTING;

#define MAXIMUM_BRIGHTNESS 255
#define MINIMUM_BRIGHTNESS 50
int brightness_value = MAXIMUM_BRIGHTNESS;
int current_brightness = MAXIMUM_BRIGHTNESS;
int brightness_step = 15;
int logo_colour[] = {RED, BLUE, GREEN, WHITE};

#define LIGHT_BUFFER_COUNT 20

extern bool temperature_logo[50][50];
extern bool steps_logo[50][50];
extern bool heart_logo[50][50];
extern bool spio2_logo[50][50];

void main(void)
{
	int err;

	err = bt_enable(NULL);
	if (err) {
		printk("Bluetooth init failed (err %d)\n", err);
		return;
	}

	bt_ready();

	bt_conn_cb_register(&conn_callbacks);
	bt_conn_auth_cb_register(&auth_cb_display);
	printk("\n\n Booting Enverse Smart Watch \n\n");
	while (display_mode == DISPLAY_MODE_BOOTING)
	{
		k_msleep(1000);
	}
	while (1)
	{
		// display_mode = DISPLAY_MODE_TIME;
		// sensor_mode = SENSOR_MODE_IDLE;
		k_msleep(5000);
		sensor_mode = SENSOR_MODE_READ_ALL;
		display_mode = DISPLAY_MODE_VALUES;
		k_msleep(10000);
		hts_indicate(38.22);
	}
}

void refresh_display()
{
	resetDisplay();
	k_msleep(1);
	LCD_Init();
	SetBrightness(current_brightness);
}
void display_task(void)
{
	LCD_Init();
	SetBrightness(255);
	while (1)
	{
		if (brightness_value > MAXIMUM_BRIGHTNESS)
			brightness_value = MAXIMUM_BRIGHTNESS;
		if (brightness_value < MINIMUM_BRIGHTNESS)
			brightness_value = MINIMUM_BRIGHTNESS;
		if (current_brightness < brightness_value)
			current_brightness += brightness_step;
		else if (current_brightness > brightness_value)
			current_brightness -= brightness_step;
		if (current_brightness > MAXIMUM_BRIGHTNESS)
			current_brightness = MAXIMUM_BRIGHTNESS;
		if (current_brightness < MINIMUM_BRIGHTNESS)
			current_brightness = MINIMUM_BRIGHTNESS;
		SetBrightness(current_brightness);
		//printf("brightness %d\n",current_brightness);
		switch (display_mode)
		{
		case DISPLAY_MODE_BOOTING:
			DispStr("BOOTING", 150, 150, WHITE, BLACK);
			static int i = 0;
			DispLogo(logo_colour[i]);
			if (i >= (sizeof(logo_colour) / sizeof(int)))
				i = 0;
			else
				i++;
			current_state_display = DISPLAY_MODE_BOOTING;
			break;
		case DISPLAY_MODE_TIME:
			if (current_state_display != DISPLAY_MODE_TIME)
				refresh_display();
			DispStr("10 : 10", 150, 150, WHITE, BLACK);
			DispStr("11/11  Wed", 130, 200, WHITE, BLACK);
			current_state_display = DISPLAY_MODE_TIME;
			break;
		case DISPLAY_MODE_VALUES:
			if (current_state_display != DISPLAY_MODE_VALUES)
			{
				refresh_display();
				DispIcon(steps_logo, BLUE, 100, 100, 50, 50);
				DispStr("Steps", 90, 160, WHITE, BLACK);

				DispIcon(heart_logo, RED, 260, 100, 50, 50);
				DispStr("H R", 264, 160, WHITE, BLACK);

				DispIcon(temperature_logo, GREEN, 100, 280, 50, 50);
				DispStr("Temp", 94, 340, WHITE, BLACK);

				DispIcon(spio2_logo, RED, 260, 280, 50, 50);
				DispStr("Spo2", 250, 340, WHITE, BLACK);
			}

			char step_count[6];
			sprintf(step_count, "%d", steps);
			DispStr(step_count, 120, 190, WHITE, BLACK); //update step count

			if (valid_hr)
			{
				char hr[6];
				sprintf(hr, "%d  ", heart_rate);
				DispStr(hr, 270, 190, WHITE, BLACK); //update hr
			}

			char temperature_value[6];
			sprintf(temperature_value, "%.2f", temp_data);
			unsigned char *t = "38.2";		   //discard the read value and use constant 38.2 as value
			DispStr(t, 90, 370, WHITE, BLACK); //update temperature

			if (valid_sp02)
			{
				char sp[6];
				sprintf(sp, "%d", sp02);
				DispStr(sp, 260, 370, WHITE, BLACK); //update spo2
			}

			if(!latch_status)
				DispStr("Detached !", 128, 30, RED, BLACK);
			else
				DispStr("Detached !", 128, 30, BLACK, BLACK);
			current_state_display = DISPLAY_MODE_VALUES;

			char Accx[6];
			mpu_data = mpu_data-213;
			sprintf(Accx, "%d", mpu_data);
			DispStr(Accx, 190, 240, WHITE, BLACK); //update acceleration

			break;
		}
	}
}

void sensors_read_task(void)
{
	initialize_bma();
	stepCounterEnable();
	init_max30102();
	set_max30102_for_reading_data();
	first_data_read();
	init_max30208();
	configure_max30208();
	configure_mpu6050();

	display_mode = DISPLAY_MODE_TIME;
	while (1)
	{
		switch (sensor_mode)
		{
		case SENSOR_MODE_IDLE:
			k_msleep(500);
			break;
		case SENSOR_MODE_READ_ALL:
			read_heart_rate_spio2(&heart_rate, &sp02, &valid_hr, &valid_sp02);
			max30208_read_temp(&temp_data);
			steps = getStepCounterOutput();
			mpu6050_read_Acc(&mpu_data);
			hrs_notify();
			// printf("Steps= %d. Temperature = %.2f . Heart Rate = %d . SpO2 = %d . MPU = %d\n", steps, temp_data, heart_rate, sp02, mpu_data);
			k_msleep(10);
			break;
		}
	}
}

void latch_sensor_task(void)
{
	init_latch();
	init_output();
	while (1)
	{
		latch_status = detect_latch();
		k_msleep(500);
	}
}

void vibration_task()
{
	while (1)
	{
		if (latch_status == false)
			toggle_motor(1); //1
		else
			toggle_motor(0); //0
		k_msleep(500);
	}
}

void buzzer_task()
{
	while (1)
	{
		if (latch_status == false)
			toggle_buzzer(1);
		k_msleep(500);
	}
}

void brightness_task()
{
	float light_data[LIGHT_BUFFER_COUNT];
	for (int i = 0; i < LIGHT_BUFFER_COUNT; i++)
		light_data[i] = AnalogRead(4);
	while (1)
	{
		float sum = 0;
		for (int i = 0; i < LIGHT_BUFFER_COUNT - 1; i++)
		{
			light_data[i] = light_data[i + 1];
			sum = sum + light_data[i];
		}
		light_data[LIGHT_BUFFER_COUNT - 1] = AnalogRead(4);
		sum = sum + light_data[LIGHT_BUFFER_COUNT - 1];
		float light_value = sum / LIGHT_BUFFER_COUNT;
		//printf("light =%f\n",light_value);
		brightness_value = 75.55 * light_value;
		k_msleep(1000);
		hrs_notify();
	}
}


K_THREAD_DEFINE(sensors_read_task_id, 1024, sensors_read_task, NULL, NULL, NULL,
				0, 0, 10);
K_THREAD_DEFINE(latch_sensor_task_id, 512, latch_sensor_task, NULL, NULL, NULL,
				0, 0, 100);
K_THREAD_DEFINE(buzzer_task_id, 256, buzzer_task, NULL, NULL, NULL,
				0, 0, 100);
K_THREAD_DEFINE(vibration_task_id, 256, vibration_task, NULL, NULL, NULL,
				0, 0, 100);
K_THREAD_DEFINE(display_task_id, 512, display_task, NULL, NULL, NULL,
				0, 0, 1000);
K_THREAD_DEFINE(brightness_task_id, 512, brightness_task, NULL, NULL, NULL,
				0, 0, 2000);
```

## src/algorithm.h
```c
/** \file algorithm.h ******************************************************
*
* Project: MAXREFDES117#
* Filename: algorithm.h
* Description: This module is the heart rate/SpO2 calculation algorithm header file
*
* Revision History:
*\n 1-18-2016 Rev 01.00 SK Initial release.
*\n
*
* --------------------------------------------------------------------
*
* This code follows the following naming conventions:
*
*\n char              ch_pmod_value
*\n char (array)      s_pmod_s_string[16]
*\n float             f_pmod_value
*\n int32_t           n_pmod_value
*\n int32_t (array)   an_pmod_value[16]
*\n int16_t           w_pmod_value
*\n int16_t (array)   aw_pmod_value[16]
*\n uint16_t          uw_pmod_value
*\n uint16_t (array)  auw_pmod_value[16]
*\n uint8_t           uch_pmod_value
*\n uint8_t (array)   auch_pmod_buffer[16]
*\n uint32_t          un_pmod_value
*\n int32_t *         pn_pmod_value
*
* ------------------------------------------------------------------------- */
/*******************************************************************************
* Copyright (C) 2015 Maxim Integrated Products, Inc., All Rights Reserved.
*
* Permission is hereby granted, free of charge, to any person obtaining a
* copy of this software and associated documentation files (the "Software"),
* to deal in the Software without restriction, including without limitation
* the rights to use, copy, modify, merge, publish, distribute, sublicense,
* and/or sell copies of the Software, and to permit persons to whom the
* Software is furnished to do so, subject to the following conditions:
*
* The above copyright notice and this permission notice shall be included
* in all copies or substantial portions of the Software.
*
* THE SOFTWARE IS PROVIDED "AS IS", WITHOUT WARRANTY OF ANY KIND, EXPRESS
* OR IMPLIED, INCLUDING BUT NOT LIMITED TO THE WARRANTIES OF
* MERCHANTABILITY, FITNESS FOR A PARTICULAR PURPOSE AND NONINFRINGEMENT.
* IN NO EVENT SHALL MAXIM INTEGRATED BE LIABLE FOR ANY CLAIM, DAMAGES
* OR OTHER LIABILITY, WHETHER IN AN ACTION OF CONTRACT, TORT OR OTHERWISE,
* ARISING FROM, OUT OF OR IN CONNECTION WITH THE SOFTWARE OR THE USE OR
* OTHER DEALINGS IN THE SOFTWARE.
*
* Except as contained in this notice, the name of Maxim Integrated
* Products, Inc. shall not be used except as stated in the Maxim Integrated
* Products, Inc. Branding Policy.
*
* The mere transfer of this software does not imply any licenses
* of trade secrets, proprietary technology, copyrights, patents,
* trademarks, maskwork rights, or any other form of intellectual
* property whatsoever. Maxim Integrated Products, Inc. retains all
* ownership rights.
*******************************************************************************
*/
#ifndef ALGORITHM_H_
#define ALGORITHM_H_
#include <errno.h>
#include <zephyr.h>
#include <sys/printk.h>
#include <device.h>

#define true 1
#define false 0
#define FS 100
#define BUFFER_SIZE (FS * 5)
#define HR_FIFO_SIZE 7
#define MA4_SIZE 4     // DO NOT CHANGE
#define HAMMING_SIZE 5 // DO NOT CHANGE
#define min(x, y) ((x) < (y) ? (x) : (y))

static int32_t an_dx[BUFFER_SIZE - MA4_SIZE]; // delta
static int32_t an_x[BUFFER_SIZE];             //ir
static int32_t an_y[BUFFER_SIZE];             //red

void maxim_heart_rate_and_oxygen_saturation(uint32_t *pun_ir_buffer, int32_t n_ir_buffer_length, uint32_t *pun_red_buffer, int32_t *pn_spo2, int8_t *pch_spo2_valid, int32_t *pn_heart_rate, int8_t *pch_hr_valid);
void maxim_find_peaks(int32_t *pn_locs, int32_t *pn_npks, int32_t *pn_x, int32_t n_size, int32_t n_min_height, int32_t n_min_distance, int32_t n_max_num);
void maxim_peaks_above_min_height(int32_t *pn_locs, int32_t *pn_npks, int32_t *pn_x, int32_t n_size, int32_t n_min_height);
void maxim_remove_close_peaks(int32_t *pn_locs, int32_t *pn_npks, int32_t *pn_x, int32_t n_min_distance);
void maxim_sort_ascend(int32_t *pn_x, int32_t n_size);
void maxim_sort_indices_descend(int32_t *pn_x, int32_t *pn_indx, int32_t n_size);

#endif /* ALGORITHM_H_ */
```

## src/bma_sensor.c
```c
#include "bma_sensor.h"
//#define logging 0

struct bma4_dev accel;
struct bma4_accel_config accel_conf;
struct bma4_dev bma456_device_global;
float devRange;

static int write_bytes(struct device *i2c_dev, u8_t addr, u8_t *data, u32_t num_bytes, u16_t slaveAddr)
{
    u8_t ret = 0x00;
#ifdef logging
    printk("Writing register - ox%x . Bytes =%d\n", addr, num_bytes);
#endif
    u8_t buffer[2];
    buffer[0] = &addr;
    buffer[1] = data;
    ret = i2c_burst_write(i2c_dev, slaveAddr, addr, data, num_bytes);
#ifdef logging
    if (ret == BMA4_OK)
        printk("Wrote Data\n");
    else
        printk("Failed to write\n");
#endif
    return ret;
}

static int read_bytes(struct device *i2c_dev, u8_t addr, u8_t *data, u32_t num_bytes, u16_t slaveAddr)
{
#ifdef logging
    printk("Reading register -ox%x . Bytes =%d\n", addr, num_bytes);
#endif
    u8_t ret = i2c_burst_read(i2c_dev, slaveAddr, addr, data, num_bytes);
#ifdef logging
    if (ret == 0x00)
        printk("Data read. Value = 0x%x\n", *(data));
#endif
    return ret;
}

/* BMA i2c write function */
static uint16_t bma_i2c_write(uint8_t reg, uint8_t *data, uint16_t len, void *intf_ptr)
{
    struct device *i2c_dev;
    i2c_dev = device_get_binding(I2C_DEV);
    return write_bytes(i2c_dev, reg, data, len, BMA4_I2C_ADDR_SECONDARY);
}

/* BMA i2c read function */
static uint16_t bma_i2c_read(u8_t reg, u8_t *data, u16_t len, void *intf_ptr)
{
    struct device *i2c_dev;
    i2c_dev = device_get_binding(I2C_DEV);
    return read_bytes(i2c_dev, reg, data, len, BMA4_I2C_ADDR_SECONDARY);
}

/* BMA delay function */
static void bma_delay_us(u32_t ms)
{
    k_busy_wait(ms);
}

/*Initialise BMA sensor */
void initialize_bma()
{
    struct device *i2c_dev;
    i2c_dev = device_get_binding(I2C_DEV);
    if (!i2c_dev)
    {
        printk("I2C: Device driver not found.\n");
        return;
    }
    uint16_t rslt = BMA4_OK;
    struct bma4_dev bma456_device;
    ////////// Device Settings /////////////
    static uint8_t dev_addr;
    dev_addr = BMA4_I2C_ADDR_SECONDARY;
    bma456_device.bus_read = bma_i2c_read;
    bma456_device.bus_write = bma_i2c_write;
    bma456_device.delay_us = bma_delay_us;
    bma456_device.read_write_len = 8;
    bma456_device.resolution = 12;
    bma456_device.feature_len = BMA456_FEATURE_SIZE;
    bma456_device.intf_ptr = &dev_addr;
    /////////////////////////////////////////
    rslt |= bma456_init(&bma456_device);
    if (rslt == BMA4_OK)
        printk("Communication with BMA : OK\n");
    else
        printk("Communication with BMA : FAILED!!! \n");

    // Soft Reset //
    bma4_set_command_register(0xB6, &bma456_device);
    ////////////////
    k_msleep(10);
    rslt = BMA4_OK;
    rslt |= bma456_write_config_file(&bma456_device);
    if (rslt == BMA4_OK)
        printk("Writing config file : OK\n");
    else
        printk("Writing config file : FAILED!!!\n");
    bma456_device_global = bma456_device;
}

u16_t init_accel()
{
    uint16_t rslt = BMA4_OK;
    struct bma4_dev bma456_device = bma456_device_global;
    /* Enable the accelerometer */
    printk("Enabling accelerometer\n");
    rslt = bma4_set_accel_enable(0x01, &bma456_device);
    if (rslt == BMA4_OK)
        printk("Enable accelerometer : OK\n");
    else
        printk("Enable accelerometer : Failed!!!\n");

    /* Declare an accelerometer configuration structure */
    //struct bma4_accel_config accel_conf;

    /* Assign the desired settings */
    accel_conf.odr = BMA4_OUTPUT_DATA_RATE_100HZ;
    accel_conf.range = BMA4_ACCEL_RANGE_2G;
    accel_conf.bandwidth = BMA4_ACCEL_NORMAL_AVG4;

    /* Set the configuration */
    rslt |= bma4_set_accel_config(&accel_conf, &bma456_device);
    if (rslt == BMA4_OK)
        printk("Accelerometer configuration : OK\n");
    else
        printk("Accelerometer configuration : FAILED!!!\n");
    return rslt;
}

struct BMA456_ACCEL_DATA read_accel()
{
    struct BMA456_ACCEL_DATA data;
    uint16_t rslt = BMA4_OK;
    struct bma4_accel sens_data;
    struct bma4_dev bma456_device = bma456_device_global;
    /* Read the sensor data into the sensor data instance */
    rslt |= bma4_read_accel_xyz(&sens_data, &bma456_device);

    /* Exit the program in case of a failure */
    if (rslt != BMA4_OK)
    {
        printk("Reading data from accelerometer : FAILED!!!");
        data.datax = 0;
        data.datay = 0;
        data.dataz = 0;
        data.result = rslt;
        return data;
    }

    /* Save the data */
    data.datax = sens_data.x;
    data.datay = sens_data.y;
    data.dataz = sens_data.z;
    data.result = rslt;
    bma456_device_global = bma456_device;
    return data;
}

u16_t stepCounterEnable()
{
    struct bma4_accel sens_data;
    struct bma4_dev bma456_device = bma456_device_global;
    uint16_t rslt = 0;
    // /* Soft-reset */
    rslt |= bma4_set_command_register(0xB6, &bma456_device);
    if (rslt == BMA4_OK)
        printk("Soft reset before enabling step counter : OK\n");
    else
        printk("Soft reset before enabling step counter : FAILED!!!\n");
    k_msleep(100);

    /* Initialize BMA456 */
    rslt |= bma456_init(&bma456_device);
    if (rslt != BMA4_OK)
    {
        printk("Testing communication with BMA : FAILED!!!\n");
        return rslt;
    }
    else
    {
        printk("Testing communication with BMA : OK\n");
    }

    /* Enable accelerometer */
    rslt = bma4_set_accel_enable(0x01, &bma456_device);
    if (rslt == BMA4_OK)
        printk("Enabling accelerometer : OK\n");
    else
    {
        printk("Enabling accelerometer : FAILED!!!\n");
        return rslt;
    }
    /* Load configuration file */
    rslt = bma456_write_config_file(&bma456_device);
    if (rslt != BMA4_OK)
    {
        printf("Load configuration fail\r\n");
        return rslt;
    }
    else
    {
        printf("Load configuration successful\r\n");
    }

    /* Enable step counter */
    rslt = bma456_feature_enable(BMA456_STEP_CNTR, 1, &bma456_device);
    if (rslt != BMA4_OK)
    {
        printf("Step counter not enabled\r\n");
        return rslt;
    }
    else
    {
        printf("Step counter enabled\r\n");
    }

    /* Map step counter interrupt */
    rslt = bma456_map_interrupt(BMA4_INTR1_MAP, BMA456_STEP_CNTR_INT, 1, &bma456_device);
    if (rslt != BMA4_OK)
    {
        printf("Error code: %d\n", rslt);
        return rslt;
    }

    /* Set water-mark level 1 */
    rslt = bma456_step_counter_set_watermark(1, &bma456_device);
    if (rslt != BMA4_OK)
    {
        printf("Error code: %d\n", rslt);
        return rslt;
    }

    // /* Load configuration file */
    // rslt = bma456_reset_step_counter(&bma456_device);
    // if (rslt == BMA4_OK)
    //     printk("Resetting stepcounter : OK\n");
    // else
    // {
    //     printk("Resetting stepcounter : FAILED!!!\n");
    //     return rslt;
    // }
    // rslt = bma456_write_config_file(&bma456_device);
    // if (rslt != BMA4_OK)
    // {
    //     printk("Load configuration file : FAILED!!!\n");
    //     return rslt;
    // }
    // else
    // {
    //     printk("Load configuration file: OK\n");
    // }

    // /* Enable step counter */
    // rslt = bma456_feature_enable(BMA456_STEP_CNTR, 1, &bma456_device);
    // if (rslt != BMA4_OK)
    // {
    //     printk("Enabling step counter : FAILED!!!\n");
    //     return rslt;
    // }
    // else
    // {
    //     printk("Enabling step counter : OK\n");
    // }

    // /* Map step counter interrupt */
    // rslt = bma456_map_interrupt(BMA4_INTR1_MAP, BMA456_STEP_CNTR_INT, 1, &bma456_device);
    // if (rslt != BMA4_OK)
    // {
    //     printk("Mapping Step counter interrupt : FAILED!!!\n Error code: %d\n", rslt);
    //     return rslt;
    // }
    // else
    //     printk("Mapping Step counter interrupt : OK\n");

    // /* Set water-mark level 1 */
    // rslt = bma456_step_counter_set_watermark(1, &bma456_device);
    // if (rslt != BMA4_OK)
    // {
    //     printk("Setting watermark : FAILED!!!\n Error code: %d\n", rslt);
    //     return rslt;
    // }
    // else
    //     printk("Setting watermark : OK\n");
    bma456_device_global = bma456_device;
    printk("Step counter init : OK\n");
    return rslt;
}

u32_t getStepCounterOutput()
{
    struct bma4_dev bma456_device = bma456_device_global;
    uint16_t rslt = 0;
    uint32_t step_out = 0;
    rslt = bma456_step_counter_output(&step_out, &bma456_device);
    if (rslt == BMA4_OK)
    {
        //printk("\nSteps counter output is %u\r\n", step_out);
    }
    else
    {
        printk("Reading step count : FAILED\n");
    }
    return step_out;
}
```

## src/bma_sensor.h
```c
#pragma once
#include <errno.h>
#include <zephyr.h>
#include <sys/printk.h>
#include <device.h>
#include <drivers/i2c.h>
#include "bma456.h"

#define I2C_DEV DT_LABEL(DT_ALIAS(i2c_0))

struct BMA456_ACCEL_DATA
{
    int datax;
    int datay;
    int dataz;
    u8_t result;
};

typedef enum
{
    CIC_AVG = 0,
    CONTINUOUS,
} MA456_PERF_MODE;

typedef enum
{
    OSR4_AVG1 = 0,
    OSR2_AVG2,
    NORMAL_AVG4,
    CIC_AVG8,
    RES_AVG16,
    RES_AVG32,
    RES_AVG64,
    RES_AVG128,
} MA456_BW;

typedef enum
{
    ODR_0_78_HZ = 1,
    ODR_1_5_HZ,
    ODR_3_1_HZ,
    ODR_6_25_HZ,
    ODR_12_5_HZ,
    ODR_25_HZ,
    ODR_50_HZ,
    ODR_100_HZ,
    ODR_200_HZ,
    ODR_400_HZ,
    ODR_800_HZ,
    ODR_1600_HZ,
} MBA456_ODR;

typedef enum
{
    RANGE_2G = 0,
    RANGE_4G,
    RANGE_8G,
    RANGE_16G,
} MA456_RANGE;

typedef enum
{
    PHONE_CONFIG = 0,
    WRIST_CONFIG = 1,
} MA456_PLATFORM_CONF;

void initialize_bma();
u16_t init_accel();
struct BMA456_ACCEL_DATA read_accel();
u16_t stepCounterEnable();

void getAcceleration(float *x, float *y, float *z);

u32_t getTemperature(void);

u32_t getStepCounterOutput(void);
```

## src/digitalPins.c
```c
#include "digitalPins.h"

struct device *globalBuzzer;
struct device *globalMotor;

s16_t init_output()
{
    struct device *buzzer;
    int ret;
    buzzer = device_get_binding(BUZZER_GPIO_LABEL);
    if (buzzer == NULL)
    {
        printk("Didn't find device %s\n", BUZZER_GPIO_LABEL);
        return -1;
    }
    ret = gpio_pin_configure(buzzer, BUZZER_GPIO_PIN, BUZZER_GPIO_FLAGS);
    if (ret != 0)
    {
        printk("Error %d: failed to configure device %s pin %d\n",
               ret, BUZZER_GPIO_LABEL, BUZZER_GPIO_PIN);
        return ret;
    }
    struct device *motor;
    motor = device_get_binding(MOTOR_GPIO_LABEL);
    if (motor == NULL)
    {
        printk("Didn't find device %s\n", MOTOR_GPIO_LABEL);
        return -1;
    }
    ret = gpio_pin_configure(motor, MOTOR_GPIO_PIN, MOTOR_GPIO_FLAGS);
    if (ret != 0)
    {
        printk("Error %d: failed to configure device %s pin %d\n",
               ret, MOTOR_GPIO_LABEL, MOTOR_GPIO_PIN);
        return ret;
    }
    printk("INITIALISING OUTPUTS : OK\n");
    globalBuzzer = buzzer;
    globalMotor = motor;
    return 0;
}

bool toggle_buzzer(bool val)
{
    if (val = 1)
    {
        for (int i = 0; i < 1000; i++)
        {
            gpio_pin_set(globalBuzzer, BUZZER_GPIO_PIN, 1);
            k_busy_wait(250);
            gpio_pin_set(globalBuzzer, BUZZER_GPIO_PIN, 0);
            k_busy_wait(250);
        }
    }
    else
        gpio_pin_set(globalBuzzer, BUZZER_GPIO_PIN, 1);
    return val;
}
bool toggle_motor(bool val)
{
    if (val)
    {
        gpio_pin_set(globalMotor, MOTOR_GPIO_PIN, 1);
        k_msleep(250);
        gpio_pin_set(globalMotor, MOTOR_GPIO_PIN, 0);
    }
    else
    {
        gpio_pin_set(globalMotor, MOTOR_GPIO_PIN, 1);
    }
}
```

## src/digitalPins.h
```c
#pragma once

#include <zephyr.h>
#include <device.h>
#include <drivers/gpio.h>
#include <sys/util.h>
#include <sys/printk.h>
#include <inttypes.h>

#define FLAGS_OR_ZERO(node)						\
	COND_CODE_1(DT_PHA_HAS_CELL(node, gpios, flags),		\
		    (DT_GPIO_FLAGS(node, gpios)),			\
		    (0))


#define BUZZER_PIN DT_ALIAS(led3)

#define BUZZER_GPIO_LABEL DT_GPIO_LABEL(BUZZER_PIN, gpios)
#define BUZZER_GPIO_PIN DT_GPIO_PIN(BUZZER_PIN, gpios)
#define BUZZER_GPIO_FLAGS (GPIO_OUTPUT|FLAGS_OR_ZERO(BUZZER_PIN))

#define MOTOR_PIN DT_ALIAS(led2)

#define MOTOR_GPIO_LABEL DT_GPIO_LABEL(MOTOR_PIN, gpios)
#define MOTOR_GPIO_PIN DT_GPIO_PIN(MOTOR_PIN, gpios)
#define MOTOR_GPIO_FLAGS (GPIO_OUTPUT |FLAGS_OR_ZERO(MOTOR_PIN))

s16_t init_output();

bool toggle_buzzer(bool val);
bool toggle_motor(bool val);
```

## src/display.c
```c
#include "display.h"

#define MAX_USER_DATA_LENGTH 1024

struct device *globalcs;
struct device *globalLcdRst;
struct device *globalVciEn;
struct device *globalDcx;                                                                

const int spi_freq = 8000000;

static uint8_t data[MAX_USER_DATA_LENGTH];

s16_t init_lcd_output()
{
    struct device *cs;
    int ret;
    cs = device_get_binding(CS_GPIO_LABEL);
    if (cs == NULL)
    {
        printk("Didn't find device %s\n", CS_GPIO_LABEL);
        return -1;
    }
    ret = gpio_pin_configure(cs, CS_GPIO_PIN, CS_GPIO_FLAGS);
    if (ret != 0)
    {
        printk("Error %d: failed to configure device %s pin %d\n",
               ret, CS_GPIO_LABEL, CS_GPIO_PIN);
        return ret;
    }

    struct device *lcdRst;
    lcdRst = device_get_binding(LCD_RST_GPIO_LABEL);
    if (lcdRst == NULL)
    {
        printk("Didn't find device %s\n", LCD_RST_GPIO_LABEL);
        return -1;
    }
    ret = gpio_pin_configure(lcdRst, LCD_RST_GPIO_PIN, LCD_RST_GPIO_FLAGS);
    if (ret != 0)
    {
        printk("Error %d: failed to configure device %s pin %d\n",
               ret, LCD_RST_GPIO_LABEL, LCD_RST_GPIO_PIN);
        return ret;
    }

    struct device *vciEn;
    vciEn = device_get_binding(VCI_EN_GPIO_LABEL);
    if (vciEn == NULL)
    {
        printk("Didn't find device %s\n", VCI_EN_GPIO_LABEL);
        return -1;
    }
    ret = gpio_pin_configure(lcdRst, VCI_EN_GPIO_PIN, VCI_EN_GPIO_FLAGS);
    if (ret != 0)
    {
        printk("Error %d: failed to configure device %s pin %d\n",
               ret, VCI_EN_GPIO_LABEL, VCI_EN_GPIO_PIN);
        return ret;
    }

    struct device *dcx;
    dcx = device_get_binding(DCX_GPIO_LABEL);
    if (dcx == NULL)
    {
        printk("Didn't find device %s\n", DCX_GPIO_LABEL);
        return -1;
    }
    ret = gpio_pin_configure(lcdRst, DCX_GPIO_PIN, DCX_GPIO_FLAGS);
    if (ret != 0)
    {
        printk("Error %d: failed to configure device %s pin %d\n",
               ret, DCX_GPIO_LABEL, DCX_GPIO_PIN);
        return ret;
    }

    printk("INITIALISING OUTPUTS : OK\n");

    globalcs = cs;
    globalLcdRst = lcdRst;
    globalVciEn = vciEn;
    globalDcx = dcx;

    return 0;
}

bool setOutputcs(bool val)
{
    int err = gpio_pin_set(globalcs, CS_GPIO_PIN, val);
    if (err != 0)
    {
        printk("Error in gpio cs");
        return 1;
    }
    return 0;
}

bool setOutputLcdRst(bool val)
{
    int err = gpio_pin_set(globalLcdRst, LCD_RST_GPIO_PIN, val);
    if (err != 0)
    {
        printk("Error in gpio reset");
        return 1;
    }
    return 0;
}

bool setOutputVciEn(bool val)
{
    int err = gpio_pin_set(globalVciEn, VCI_EN_GPIO_PIN, val);
    if (err != 0)
    {
        printk("Error in gpio vcien");
        return 1;
    }
    return 0;
}

bool setOutputDcx(bool val)
{
    int err = gpio_pin_set(globalDcx, DCX_GPIO_PIN, val);
    if (err != 0)
    {
        printk("Error in gpio dcx");
        return 1;
    }
    return 0;
}

static int spi_acess(const struct device *spi, struct spi_config *spi_cfg, uint8_t cmd, uint16_t addr, void *data, size_t len)
{
    uint8_t access[2];
    struct spi_buf bufs[] =
        {
            {.buf = data,
             .len = len}
        };
    struct spi_buf_set tx =
        {
            .buffers = bufs,
            .count = 1
        };
    return spi_write(spi, spi_cfg, &tx);
}

int write_bytes(const struct device *spi, struct spi_config *spi_cfg,
                       uint16_t addr, uint8_t *data, uint32_t num_bytes)
{
    int err;
    err = spi_acess(spi, spi_cfg, 0, addr, data, num_bytes);
    if (err)
    {
        printk("Error during SPI write\n");
        return -EIO;
    }
    return 0;
}

int read_bytes(const struct device *spi, struct spi_config *spi_cfg,
                      uint16_t addr, uint8_t *data, uint32_t num_bytes)
{
    int err;
    err = spi_acess(spi, spi_cfg, 1, addr, data, num_bytes);
    if (err)
    {
        printk("Error during SPI read\n");
        return -EIO;
    }
    return 0;
}
```

## src/display.h
```c
#pragma once


#include <errno.h>
#include <zephyr.h>
#include <sys/printk.h>
#include <device.h>
#include <drivers/spi.h>
#include <drivers/gpio.h>
#include <sys/util.h>
#include <inttypes.h>

#define FLAGS_OR_ZERO(node)						\
	COND_CODE_1(DT_PHA_HAS_CELL(node, gpios, flags),		\
		    (DT_GPIO_FLAGS(node, gpios)),			\
		    (0))

#define CS_NODE DT_ALIAS(led0)

#if DT_NODE_HAS_STATUS(CS_NODE, okay) && DT_NODE_HAS_PROP(CS_NODE, gpios)
#define CS_GPIO_LABEL DT_GPIO_LABEL(CS_NODE, gpios)
#define CS_GPIO_PIN DT_GPIO_PIN(CS_NODE, gpios)
#define CS_GPIO_FLAGS (GPIO_OUTPUT | FLAGS_OR_ZERO(CS_NODE))
#endif

#define LCD_RST_NODE DT_ALIAS(led1)

#if DT_NODE_HAS_STATUS(LCD_RST_NODE, okay) && DT_NODE_HAS_PROP(LCD_RST_NODE, gpios)
#define LCD_RST_GPIO_LABEL DT_GPIO_LABEL(LCD_RST_NODE, gpios)
#define LCD_RST_GPIO_PIN DT_GPIO_PIN(LCD_RST_NODE, gpios)
#define LCD_RST_GPIO_FLAGS (GPIO_OUTPUT | FLAGS_OR_ZERO(LCD_RST_NODE))
#endif

#define VCI_EN_NODE DT_ALIAS(led4)

#if DT_NODE_HAS_STATUS(VCI_EN_NODE, okay) && DT_NODE_HAS_PROP(VCI_EN_NODE, gpios)
#define VCI_EN_GPIO_LABEL DT_GPIO_LABEL(VCI_EN_NODE, gpios)
#define VCI_EN_GPIO_PIN DT_GPIO_PIN(VCI_EN_NODE, gpios)
#define VCI_EN_GPIO_FLAGS (GPIO_OUTPUT | FLAGS_OR_ZERO(VCI_EN_NODE))
#endif

#define DCX_NODE DT_ALIAS(led5)

#if DT_NODE_HAS_STATUS(DCX_NODE, okay) && DT_NODE_HAS_PROP(DCX_NODE, gpios)
#define DCX_GPIO_LABEL DT_GPIO_LABEL(DCX_NODE, gpios)
#define DCX_GPIO_PIN DT_GPIO_PIN(DCX_NODE, gpios)
#define DCX_GPIO_FLAGS (GPIO_OUTPUT | FLAGS_OR_ZERO(DCX_NODE))
#endif


s16_t init_lcd_output();
bool setOutputcs(bool val);
bool setOutputLcdRst(bool val);
bool setOutputVciEn(bool val);
bool setOutputDcx(bool val);

int write_bytes(const struct device *spi, struct spi_config *spi_cfg,
		       uint16_t addr, uint8_t *data, uint32_t num_bytes);
int read_bytes(const struct device *spi, struct spi_config *spi_cfg,
		      uint16_t addr, uint8_t *data, uint32_t num_bytes);
              
```

## src/heart_algorithm.h
```c
#pragma once
/*
 * Created by Robert Fraczkiewicz, 01/2018
 * New signal processing methodology for obtaining heart rate and SpO2 data 
 * from the MAX30102 sensor manufactured by MAXIM Integrated Products, Inc.
 */
/*******************************************************************************
* Copyright (C) 2017 Robert Fraczkiewicz, All Rights Reserved.
*
* Permission is hereby granted, free of charge, to any person obtaining a
* copy of this software and associated documentation files (the "Software"),
* to deal in the Software without restriction, including without limitation
* the rights to use, copy, modify, merge, publish, distribute, sublicense,
* and/or sell copies of the Software, and to permit persons to whom the
* Software is furnished to do so, subject to the following conditions:
*
* The above copyright notice and this permission notice shall be included
* in all copies or substantial portions of the Software.
*
* THE SOFTWARE IS PROVIDED "AS IS", WITHOUT WARRANTY OF ANY KIND, EXPRESS
* OR IMPLIED, INCLUDING BUT NOT LIMITED TO THE WARRANTIES OF
* MERCHANTABILITY, FITNESS FOR A PARTICULAR PURPOSE AND NONINFRINGEMENT.
* IN NO EVENT SHALL ROBERT FRACZKIEWICZ BE LIABLE FOR ANY CLAIM, DAMAGES
* OR OTHER LIABILITY, WHETHER IN AN ACTION OF CONTRACT, TORT OR OTHERWISE,
* ARISING FROM, OUT OF OR IN CONNECTION WITH THE SOFTWARE OR THE USE OR
* OTHER DEALINGS IN THE SOFTWARE.
*
* The mere transfer of this software does not imply any licenses
* of trade secrets, proprietary technology, copyrights, patents,
* trademarks, maskwork rights, or any other form of intellectual
* property whatsoever. Robert Fraczkiewicz retains all
* ownership rights.
*******************************************************************************
*/
#ifndef ALGORITHM_BY_RF_H_
#define ALGORITHM_BY_RF_H_


#include <errno.h>
#include <zephyr.h>
#include <sys/printk.h>
#include <device.h>
#include <drivers/i2c.h>


void rf_heart_rate_and_oxygen_saturation(uint32_t *pun_ir_buffer, uint32_t n_ir_buffer_length, uint32_t *pun_red_buffer, float *pn_spo2, int8_t *pch_spo2_valid, uint32_t *pn_heart_rate, 
                                        int8_t *pch_hr_valid, float *ratio, float *correl);
float rf_linear_regression_beta(float *pn_x, float xmean, float sum_x2);
float rf_autocorrelation(float *pn_x, uint32_t n_size, uint32_t n_lag);
float rf_rms(float *pn_x, uint32_t n_size, float *sumsq);
float rf_Pcorrelation(float *pn_x, float *pn_y, uint32_t n_size);
void rf_initialize_periodicity_search(float *pn_x, uint32_t n_size, uint32_t *p_last_periodicity, uint32_t n_max_distance, float min_aut_ratio, float aut_lag0);
void rf_signal_periodicity(float *pn_x, uint32_t n_size, uint32_t *p_last_periodicity, uint32_t n_min_distance, uint32_t n_max_distance, float min_aut_ratio, float aut_lag0, float *ratio);

#endif /* ALGORITHM_BY_RF_H_ */
```

## src/hts.c
```c
/** @file
 *  @brief HTS Service sample
 */

/*
 * Copyright (c) 2020 SixOctets Systems
 * Copyright (c) 2019 Aaron Tsui <aaron.tsui@outlook.com>
 *
 * SPDX-License-Identifier: Apache-2.0
 */

#include <stdio.h>
#include <stddef.h>
#include <string.h>
#include <errno.h>

#include <zephyr.h>
#include <drivers/sensor.h>
#include <sys/printk.h>
#include <sys/byteorder.h>

#include <bluetooth/bluetooth.h>
#include <bluetooth/hci.h>
#include <bluetooth/conn.h>
#include <bluetooth/uuid.h>
#include <bluetooth/gatt.h>

static const struct device *temp_dev;

static uint8_t simulate_htm;
static uint8_t indicating;
static struct bt_gatt_indicate_params ind_params;

static void htmc_ccc_cfg_changed(const struct bt_gatt_attr *attr,
				 uint16_t value)
{
	simulate_htm = (value == BT_GATT_CCC_INDICATE) ? 1 : 0;
}

static void indicate_cb(struct bt_conn *conn,
			struct bt_gatt_indicate_params *params, uint8_t err)
{
	printk("Indication %s\n", err != 0U ? "fail" : "success");
}

static void indicate_destroy(struct bt_gatt_indicate_params *params)
{
	printk("Indication complete\n");
	indicating = 0U;
}

/* Thermometer Service Declaration */
BT_GATT_SERVICE_DEFINE(hts_svc,
	BT_GATT_PRIMARY_SERVICE(BT_UUID_HTS),
	BT_GATT_CHARACTERISTIC(BT_UUID_HTS_MEASUREMENT, BT_GATT_CHRC_INDICATE,
			       BT_GATT_PERM_NONE, NULL, NULL, NULL),
	BT_GATT_CCC(htmc_ccc_cfg_changed,
		    BT_GATT_PERM_READ | BT_GATT_PERM_WRITE),
	/* more optional Characteristics */
);

void hts_init(void)
{
	temp_dev = device_get_binding("TEMP_0");

	if (!temp_dev) {
		printk("error: no temp device\n");
		return;
	}

	printk("temp device is %p, name is %s\n", temp_dev,
	       temp_dev->name);
}

void hts_indicate(double temp)
{
	/* Temperature measurements simulation */
	struct sensor_value temp_value;

	if (simulate_htm) {
		static uint8_t htm[5];
		// static double temperature = 20U;
		uint32_t mantissa;
		uint8_t exponent;
		int r;

		if (indicating) {
			return;
		}
		
		printf("temperature is %g C\n", temp);

		mantissa = (uint32_t)(temp * 100);
		exponent = (uint8_t)-2;

		htm[0] = 0; /* temperature in celcius */
		sys_put_le24(mantissa, (uint8_t *)&htm[1]);
		htm[4] = exponent;

		ind_params.attr = &hts_svc.attrs[2];
		ind_params.func = indicate_cb;
		ind_params.destroy = indicate_destroy;
		ind_params.data = &htm;
		ind_params.len = sizeof(htm);

		if (bt_gatt_indicate(NULL, &ind_params) == 0) {
			indicating = 1U;
		}
	}
}
```
