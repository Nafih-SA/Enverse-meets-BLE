## build/Kconfig/Kconfig.modules
```kconfig
menu "hal_nordic (C:\Users\one\Documents\Zephyr\modules\hal\nordic)"
osource "$(ZEPHYR_HAL_NORDIC_KCONFIG)"
config ZEPHYR_HAL_NORDIC_MODULE
	bool
	default y
endmenu
menu "sof (C:\Users\one\Documents\Zephyr\modules\audio\sof)"
osource "C:/Users/one/Documents/Zephyr/modules/audio/sof/zephyr/Kconfig"
config ZEPHYR_SOF_MODULE
	bool
	default y
endmenu
```

## build/Kconfig/Kconfig.shield
```kconfig
osource "C:/Users/one/Documents/Zephyr/zephyr/boards/shields/*/Kconfig.shield"
osource "C:/Users/one/Documents/Zephyr/zephyr/boards/shields/*/Kconfig.shield"
```

## build/Kconfig/Kconfig.shield.defconfig
```kconfig
osource "C:/Users/one/Documents/Zephyr/zephyr/boards/shields/*/Kconfig.defconfig"
osource "C:/Users/one/Documents/Zephyr/zephyr/boards/shields/*/Kconfig.defconfig"
```

## build/Kconfig/Kconfig.soc.arch
```kconfig
osource "C:/Users/one/Documents/Zephyr/zephyr/soc/$(ARCH)/Kconfig"
osource "C:/Users/one/Documents/Zephyr/zephyr/soc/$(ARCH)/*/Kconfig"
```
